#include <LOLIN_I2C_BUTTON.h>
#include <pgmspace.h>
#include <SPI.h>
#include <Wire.h>
#include <Adafruit_BMP085.h>
#include <Adafruit_GFX.h>
#include <Adafruit_SSD1306.h>

#define SCREEN_WIDTH 128
#define SCREEN_HEIGHT 64

 // Declaration for SSD1306 display connected using I2C
#define OLED_RESET  0 // Reset pin
#define SCREEN_ADDRESS 0x3C
Adafruit_SSD1306 display(SCREEN_WIDTH, SCREEN_HEIGHT, &Wire, OLED_RESET);

Adafruit_BMP085 bmp;

const unsigned int bitmap [] = {
  1,1,1,1,1,1,1,1,1,1,1,1,1,1,1,1,1,1,1,1,1,1,1,1,1,1,1,1,1,1,1,1,1,1,1,1,1,1,1,
  1,1,1,1,1,1,1,1,1,1,1,1,1,1,1,1,1,1,1,1,1,1,1,1,1,1,1,1,1,1,1,1,1,1,1,1,1,1,1,
  1,1,1,1,1,1,1,1,1,1,1,1,1,1,1,1,1,1,1,1,1,1,1,1,1,1,1,1,1,1,1,1,1,1,1,1,1,1,1,
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  1,1,1,1,1,1,1,1,1,1,1,1,1,1,1,1,1,1,1,1,1,1,1,1,1,1,1,1,1,1
};

void drawBitmap(void)
{
 int i = 0;
 for(int x = 0; x < SCREEN_WIDTH; x++)
 {
  for(int y = 0; y < SCREEN_HEIGHT; y++)
  {
   if (bitmap[i] == 1)
   {
    display.drawPixel(SCREEN_WIDTH-(40+x),SCREEN_HEIGHT-(y-8),WHITE);
   }
   else
   {
    display.drawPixel(SCREEN_WIDTH-(40+x),SCREEN_HEIGHT-(y-8),BLACK);
   }
   i++;
  }
 }
}

void setup() {
  
  Serial.begin(9600);
  Wire.begin(8, 10);
  
   if (!bmp.begin()) {
  Serial.println("Could not find a valid BMP085/BMP180 sensor, check wiring!");
  while (1) {}
  } 
   // initialize the OLED object
 display.begin(SSD1306_SWITCHCAPVCC, SCREEN_ADDRESS);

 display.clearDisplay();
 drawBitmap();
 display.display(); 
}
  
void loop()
{
  delay(2000);
// intialize by Clearing the display.
  display.clearDisplay();
  display.setTextSize(1.15);
  display.setTextColor(WHITE);
  display.setCursor(33,16);
  display.print("T:");
  display.print(bmp.readTemperature());
  display.println(" C");
  
  display.setTextSize(1.15);
  display.setTextColor(WHITE); 
  display.setCursor(33,30);
  display.print("P:");

  float mb = bmp.readPressure() / 100;

  display.print((int) mb);
  display.println(" mB");
  
  // Calculate altitude assuming 'standard' barometric
  // pressure of 1013.25 millibar = 101325 Pascal
  display.setTextSize(1.15);
  display.setTextColor(WHITE);
  display.setCursor(33,43);
  display.print("A:");
  display.print(bmp.readAltitude());
  display.println(" M");

  display.setTextSize(1.15);
  display.setTextColor(WHITE);
  display.setCursor(33,56);
  display.print("W:");
  
  if (mb > 1035) 
  {
    display.print("DRY");
  }
  else if (mb > 1010)
  {
    display.print("FAIR");
  }
  else if (mb < 965)
  {
    display.print("STORMY");
  }
  else if (mb < 990)
  {
    display.print("RAINY");
  }
  else
  {
    display.print("CHANGING");
  }
  
  display.display(); 
}
